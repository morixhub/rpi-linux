/dts-v1/;
/plugin/;

/{
	compatible = "brcm,bcm2711";

	fragment@0 {
		target = <&uart3>;
		__overlay__ {
			pinctrl-names = "default";
			pinctrl-0 = <&uart3_pins>;
			status = "okay";
		};
	};

	fragment@1 {
		target = <&gpio>;
		__overlay__ {
			uart3_pins: uart3_pins {
				brcm,pins = <4 5>;
				brcm,function = <3>; /* alt4 */
				brcm,pull = <2 2>;
			};
		};
	};

	__overrides__ {
		ctsrts = <0>,"=1";
	};
};
