/dts-v1/;
/plugin/;

/{
	compatible = "brcm,bcm2711";

	fragment@0 {
		target = <&uart4>;
		__overlay__ {
			pinctrl-names = "default";
			pinctrl-0 = <&uart4_pins>;
			status = "okay";
		};
	};

	fragment@1 {
		target = <&gpio>;
		__overlay__ {
			uart4_pins: uart4_pins {
				brcm,pins = <8 9>;
				brcm,function = <3>; /* alt4 */
				brcm,pull = <2 1>;
			};
		};
	};

	__overrides__ {
		ctsrts = <0>,"=1";
	};
};
